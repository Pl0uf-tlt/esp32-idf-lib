## sht3x/Kconfig
```kconfig
menu "SHT3X I2C configuration"

    menu "I2C Master"
        config I2C_MASTER_SCL
            int "SCL GPIO Num"
            default 5
            help
                GPIO number for I2C Master clock line.

        config I2C_MASTER_SDA
            int "SDA GPIO Num"
            default 4
            help
                GPIO number for I2C Master data line.

        config I2C_MASTER_PORT_NUM
            int "Port Number"
            default 0
            help
                Port number for I2C Master device.

        config I2C_MASTER_FREQUENCY
            int "Master Frequency"
            default 100000
            help
                I2C Speed of Master device. 
                Standard is set by default.
                Standard = 100kHz.
                Fast = 400kHz
                
        config I2C_TIMEOUT
            int "I2C transaction timeout, milliseconds"
            default 1000
            range 10 5000
                
    endmenu

endmenu
```
